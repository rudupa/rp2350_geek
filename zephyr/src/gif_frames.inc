    { /* frame 0: small dot */
        0,0,0,0,0,0,0,0,0,0,0,0,
        0,0,0,0,0,0,0,0,0,0,0,0,
        0,0,0,0,0,0,0,0,0,0,0,0,
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        0,0,0,0,0,0,0,0,0,0,0,0,
    },
    { /* frame 1: medium ring */
        0,0,0,0,0,0,0,0,0,0,0,0,
        0,0,0,1,1,1,1,1,1,0,0,0,
        0,0,1,2,2,2,2,2,2,1,0,0,
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        0,0,0,0,0,0,0,0,0,0,0,0,
    },
    { /* frame 2: large ring */
        0,0,1,1,1,1,1,1,1,1,1,0,
        0,1,2,2,2,2,2,2,2,2,2,1,
        1,2,1,1,1,1,1,1,1,1,1,2,
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        0,0,1,1,1,1,1,1,1,1,1,0,
    }
